## boards/nucleo-h755zi-q/Kconfig
```kconfig
# SPDX-FileCopyrightText: 2026 COGIP Robotics association
# SPDX-License-Identifier: LGPL-2.1-only

config BOARD
    default "nucleo-h755zi-q" if BOARD_NUCLEO_H755ZI_Q

config BOARD_NUCLEO_H755ZI_Q
    bool
    default y
    select BOARD_COMMON_NUCLEO144
    select CPU_MODEL_STM32H755ZI

source "$(RIOTBOARD)/common/nucleo144/Kconfig"
```

## boards/stm32h573i-dk/Kconfig
```kconfig
# SPDX-FileCopyrightText: 2026 Cogip
# SPDX-License-Identifier: LGPL-2.1-only

config BOARD
    default "stm32h573i-dk" if BOARD_STM32H573I_DK

config BOARD_STM32H573I_DK
    bool
    default y
    select CPU_MODEL_STM32H573II

    # Clock configuration
    select BOARD_HAS_HSE
    select BOARD_HAS_LSE


config CLOCK_HSE
    default 25000000


source "$(RIOTBOARD)/common/stm32/Kconfig"
```

## cpu/stm32/kconfigs/h5/Kconfig
```kconfig
# SPDX-FileCopyrightText: 2026 Cogip
# SPDX-License-Identifier: LGPL-2.1-only

config CPU_FAM_H5
    bool
    select CPU_STM32
    select CPU_CORE_CORTEX_M33

config CPU_FAM
    default "h5" if CPU_FAM_H5
```

## cpu/stm32/kconfigs/h5/Kconfig.lines
```kconfig
# SPDX-FileCopyrightText: 2026 Cogip
# SPDX-License-Identifier: LGPL-2.1-only

# CPU lines
config CPU_LINE_STM32H503XX
    bool
    select CPU_FAM_H5

config CPU_LINE_STM32H523XX
    bool
    select CPU_FAM_H5

config CPU_LINE_STM32H533XX
    bool
    select CPU_FAM_H5

config CPU_LINE_STM32H562XX
    bool
    select CPU_FAM_H5

config CPU_LINE_STM32H563XX
    bool
    select CPU_FAM_H5

config CPU_LINE_STM32H573XX
    bool
    select CPU_FAM_H5
```

## cpu/stm32/kconfigs/h5/Kconfig.models
```kconfig
# SPDX-FileCopyrightText: 2026 Cogip
# SPDX-License-Identifier: LGPL-2.1-only

# CPU models
config CPU_MODEL_STM32H573II
    bool
    select CPU_LINE_STM32H573XX

config CPU_MODEL_STM32H573ZI
    bool
    select CPU_LINE_STM32H573XX

config CPU_MODEL_STM32H573VI
    bool
    select CPU_LINE_STM32H573XX

config CPU_MODEL_STM32H573RI
    bool
    select CPU_LINE_STM32H573XX

config CPU_MODEL_STM32H563II
    bool
    select CPU_LINE_STM32H563XX

config CPU_MODEL_STM32H563ZI
    bool
    select CPU_LINE_STM32H563XX

config CPU_MODEL_STM32H563VI
    bool
    select CPU_LINE_STM32H563XX

config CPU_MODEL_STM32H563RI
    bool
    select CPU_LINE_STM32H563XX

config CPU_MODEL_STM32H503RB
    bool
    select CPU_LINE_STM32H503XX

config CPU_MODEL_STM32H503CB
    bool
    select CPU_LINE_STM32H503XX

config CPU_MODEL_STM32H503KB
    bool
    select CPU_LINE_STM32H503XX

# Configure CPU model
config CPU_MODEL
    default "stm32h503cb" if CPU_MODEL_STM32H503CB
    default "stm32h503kb" if CPU_MODEL_STM32H503KB
    default "stm32h503rb" if CPU_MODEL_STM32H503RB
    default "stm32h563ri" if CPU_MODEL_STM32H563RI
    default "stm32h563vi" if CPU_MODEL_STM32H563VI
    default "stm32h563zi" if CPU_MODEL_STM32H563ZI
    default "stm32h563ii" if CPU_MODEL_STM32H563II
    default "stm32h573ri" if CPU_MODEL_STM32H573RI
    default "stm32h573vi" if CPU_MODEL_STM32H573VI
    default "stm32h573zi" if CPU_MODEL_STM32H573ZI
    default "stm32h573ii" if CPU_MODEL_STM32H573II
```

## drivers/max1161x/Kconfig
```kconfig
# Copyright (C) 2025 Mathis LECRIVAIN <lecrivain.mathis@gmail.com>
#
# This file is subject to the terms and conditions of the GNU Lesser
# General Public License v2.1. See the file LICENSE in the top level
# directory for more details.
#

menuconfig MODULE_MAX1161X
    bool
    prompt "MAX1161X Analog-to-Digital converter" if !(SAUL_DEFAULT && HAVE_MAX1161X)
    default SAUL_DEFAULT && HAVE_MAX1161X
    depends on HAS_PERIPH_GPIO
    depends on HAS_PERIPH_GPIO_IRQ
    depends on HAS_PERIPH_I2C
    depends on TEST_KCONFIG
    select MODULE_PERIPH_GPIO
    select MODULE_PERIPH_GPIO_IRQ
    select MODULE_PERIPH_I2C

choice MAX1161X_VARIANT
    bool "Variants"
    depends on MODULE_MAX1161X
    default MODULE_MAX11612 if HAVE_MAX11612
    default MODULE_MAX11613 if HAVE_MAX11613
    default MODULE_MAX11614 if HAVE_MAX11614
    default MODULE_MAX11615 if HAVE_MAX11615
    default MODULE_MAX11616 if HAVE_MAX11616
    default MODULE_MAX11617 if HAVE_MAX11617
    help
        This driver works with max11612, max11613, max11614, max11615, max11616 and max11617 models. Select one.

config MODULE_MAX11612
    bool "MAX11612"

config MODULE_MAX11613
    bool "MAX11613"

config MODULE_MAX11614
    bool "MAX11614"

config MODULE_MAX11615
    bool "MAX11615"

config MODULE_MAX11616
    bool "MAX11616"

config MODULE_MAX11617
    bool "MAX11617"

endchoice

config HAVE_MAX1161X
    bool
    help
        Indicates that MAX1161X Analog-to-Digital is present.

config HAVE_MAX11612
    bool
    select HAVE_MAX1161X
    help
        Indicates that MAX11612 Analog-to-Digital is present.

config HAVE_MAX11613
    bool
    select HAVE_MAX1161X
    help
        Indicates that MAX11613 Analog-to-Digital is present.

config HAVE_MAX11614
    bool
    select HAVE_MAX1161X
    help
        Indicates that MAX11614 Analog-to-Digital is present.

config HAVE_MAX11615
    bool
    select HAVE_MAX1161X
    help
        Indicates that MAX11615 Analog-to-Digital is present.

config HAVE_MAX11616
    bool
    select HAVE_MAX1161X
    help
        Indicates that MAX11616 Analog-to-Digital is present.

config HAVE_MAX11617
    bool
    select HAVE_MAX1161X
    help
        Indicates that MAX11617 Analog-to-Digital is present.
```
